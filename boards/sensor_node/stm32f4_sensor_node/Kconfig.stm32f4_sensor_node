## boards/sensor_node/stm32f4_sensor_node/Kconfig.stm32f4_sensor_node
```kconfig
# Copyright (c) 2016 Linaro Limited.
# SPDX-License-Identifier: Apache-2.0

config BOARD_STM32F4_SENSOR_NODE
	select SOC_STM32F407XG
```

## boards/sensor_node/stm32f4_sensor_node/board.yml
```yaml
board:
  name: stm32f4_sensor_node
  full_name: STM32F4 Sensor Node
  vendor: sensor_node
  socs:
    - name: stm32f407xx
```

## boards/st/sensor_node1/Kconfig.sensor_node1
```kconfig
# Copyright (c) 2016 Linaro Limited.
# SPDX-License-Identifier: Apache-2.0

config BOARD_SENSOR_NODE1
	select SOC_STM32F407XG
```

## boards/st/sensor_node1/board.yml
```yaml
board:
  name: sensor_node1
  full_name: Sensor Node 1
  vendor: st
  socs:
    - name: stm32f407xx
```
